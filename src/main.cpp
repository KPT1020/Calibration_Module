#include <Arduino.h>
#include <stdio.h>
#include <string.h>
#include <SPI.h>
#include <math.h>
#include <Adafruit_ADS1X15.h>

Adafruit_ADS1115 ads;
#define SAMPLE_LENGTH 8500

short array[SAMPLE_LENGTH] = {7192 ,7210 ,7200 ,7190 ,7190 ,7192 ,7202 ,7200 ,7186 ,7220 ,7215 ,7190 ,7210 ,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7220 ,7220};
int counter1=0;
int counter2= 0;
int buffer[100];

const int freq = 5000;
const int resolution = 8;
const int zone = 5000;
double filtered_array[SAMPLE_LENGTH]={0};

void setup() {
// const int lag = 60;
// const float threshold = 5;
// const float influence = 0.2;
// int signal[SAMPLE_LENGTH];
// int filteredY[lag];

  // put your setup code here, to run once:
 if (!ads.begin()) {
    Serial.println("Failed to initialize ADS.");
    while (1);
  }
  pinMode(25,OUTPUT);
  dacWrite(25,70);
  pinMode(27,OUTPUT);
  ledcSetup(2, freq, resolution);
  ledcAttachPin(27, 2);
  ledcWrite(2, 150);
}


void loop() { //put your main code here, to run repeatedly:
  delay(5000);
  long previous = millis(); 
  printf("start");
  // while(millis() - previous < 20000){
  //   array[counter1] = ads.readADC_SingleEnded(1);
  //   printf(" %d\n", array[counter1]);
  //   counter1 += 1;
  // }
  // printf("Counter 1: &d\n", counter1);

  for(int i = 0; i < sizeof(array)/sizeof(array[0])-10; i ++){
    if (array[i] != 0){
      int sum = 0;
      double mean;
      for( int j = 0; j <10 ; j++){
        sum = sum + array[i+j];
      } 
      mean = sum/10.00;
      delay(1);
      printf("%.2f\n",mean);
      filtered_array[i] = mean;
    }
  }

  for (int q = 0; q < sizeof(array)/sizeof(array[0])-10 -200; q ++){
    printf("%d\n",q);
    int diff = filtered_array[q+99] -filtered_array[q];
    int diff2= filtered_array[q+199] - filtered_array[q+99];
    int diff3 = filtered_array[q+99-5] -filtered_array[q+99+5];
    printf("Previous : %d, Difference:  %d\n",diff,diff2);
    // if(diff >15 && diff2< -15 && (fabsf(filtered_array[i]-filtered_array[i+199])<10||fabsf(filtered_array[i]-filtered_array[i+199]) > 50)){
    if(diff >15 && diff2< -15 && fabsf(diff3)<10){
      buffer[counter2] = q+99;
      counter2 += 1;
    } 
    delay(1);
  }

  int previous_buf= buffer[0];
  int peak_count= 1;
  int position[10] = {0};
  int position_average=0;
  int position_counter=0;
  for (int j = 0; j < 100; j++){
    if(buffer[j] != 0){
      printf("Grabbed point %d : %d\n",j+1,buffer[j]);
      if(buffer[j]-previous_buf >100){
        position_average = position_average/position_counter;
        position[peak_count-1]= position_average;
        
        peak_count +=1;

        position_average = 0;
        position_counter = 0;
      }
      position_average += buffer[j];
      printf("position sum: %d\n",position_average);
      position_counter += 1;
      printf("position counte: %d\n",position_counter);
      
      previous_buf = buffer[j];
    }
  }
  position_average = position_average/position_counter;
  position[peak_count-1]= position_average;
  printf("Peak Total: %d\n", peak_count);
  printf("Peak position: %d , %d\n", position[0],  position[1]);

  while(1);
}


// float stddev(float data[], int len);
// float mean(float data[], int len);
// void thresholding(float y[], int signals[], int lag, float threshold, float influence);

// void thresholding(float y[], int signals[], int lag, float threshold, float influence){
//   memset(signals, 0, sizeof(int) * SAMPLE_LENGTH); //copy a bunch of zeros
//   float filteredY[SAMPLE_LENGTH];
//   memcpy(filteredY, y, sizeof(float) * SAMPLE_LENGTH); // copy
//   float avgFilter[SAMPLE_LENGTH] = {0};
//   float stdFilter[SAMPLE_LENGTH] = {0};
//   avgFilter[lag - 1] = mean(y, lag);
//   stdFilter[lag - 1] = stddev(y, lag);

//   for(int i = lag; i < SAMPLE_LENGTH; i ++){ // start checking after the filter is applied first
//     if (abs(y[i] - avgFilter[i-1]) > threshold * stdFilter[i-1]) { //check the absolute difference between input and avgfiltered signlal
//       if (y[i] > avgFilter[i-1]) {
//         signals[i] = 1; // indicate add peak
//       } 
//       else {
//         signals[i] = -1; // indicate add troph
//       }
//       filteredY[i] = influence * y[i] + (1 - influence) * filteredY[i-1]; // update the meand filter and std filter
//     } 
//     else {
//       signals[i] = 0; // neither peak or troph
//     }
//     printf("%d\n",signals[i]);
//     avgFilter[i] = mean(filteredY + i-lag, lag); // update mean filter with updated processed signal
//     stdFilter[i] = stddev(filteredY + i-lag, lag);
//   }
// }


// float mean(float data[], int len) {
//     float sum = 0.0, mean = 0.0;

//     int i;
//     for(i=0; i<len; ++i) {
//         sum += data[i];
//     }

//     mean = sum/len;
//     return mean;
// }

// float stddev(float data[], int len) {
//     float the_mean = mean(data, len);
//     float standardDeviation = 0.0;

//     int i;
//     for(i=0; i<len; ++i) {
//         standardDeviation += pow(data[i] - the_mean, 2);
//     }

//     return sqrt(standardDeviation/len);
// }





